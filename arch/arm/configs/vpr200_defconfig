## arch/arm/configs/vpr200_defconfig
```kconfig
CONFIG_ARCH_IMX=y
CONFIG_ARCH_IMX_INTERNAL_BOOT_NOR=y
CONFIG_ARCH_IMX35=y
CONFIG_MACH_VPR200=y
CONFIG_IMX_CLKO=y
CONFIG_AEABI=y
CONFIG_ARM_OPTIMZED_STRING_FUNCTIONS=y
CONFIG_TEXT_BASE=0x87F00000
CONFIG_MALLOC_SIZE=0x4000000
CONFIG_EXPERIMENTAL=y
CONFIG_LONGHELP=y
CONFIG_GLOB=y
CONFIG_CMDLINE_EDITING=y
CONFIG_AUTO_COMPLETE=y
CONFIG_PARTITION=y
CONFIG_DEFAULT_ENVIRONMENT_GENERIC=y
CONFIG_DEFAULT_ENVIRONMENT_PATH="arch/arm/boards/vpr200/env/"
CONFIG_DEBUG_INFO=y
CONFIG_ENABLE_DEVICE_NOISE=y
CONFIG_CMD_EDIT=y
CONFIG_CMD_SLEEP=y
CONFIG_CMD_SAVEENV=y
CONFIG_CMD_LOADENV=y
CONFIG_CMD_EXPORT=y
CONFIG_CMD_PRINTENV=y
CONFIG_CMD_READLINE=y
CONFIG_CMD_MEMINFO=y
CONFIG_CMD_MTEST=y
CONFIG_CMD_FLASH=y
CONFIG_CMD_BOOTM_SHOW_TYPE=y
CONFIG_CMD_RESET=y
CONFIG_CMD_GO=y
CONFIG_CMD_TIMEOUT=y
CONFIG_CMD_PARTITION=y
# CONFIG_CMD_HELP is not set
CONFIG_CMD_BMP=y
CONFIG_CMD_GPIO=y
CONFIG_CMD_I2C=y
CONFIG_CMD_LED=y
CONFIG_NET=y
CONFIG_NET_DHCP=y
CONFIG_NET_PING=y
CONFIG_NET_TFTP=y
CONFIG_DRIVER_NET_FEC_IMX=y
# CONFIG_SPI is not set
CONFIG_DRIVER_CFI=y
CONFIG_CFI_BUFFER_WRITE=y
CONFIG_MTD=y
CONFIG_NAND=y
CONFIG_NAND_IMX=y
CONFIG_VIDEO=y
CONFIG_DRIVER_VIDEO_IMX_IPU=y
CONFIG_MCI=y
CONFIG_MCI_STARTUP=y
CONFIG_MCI_IMX_ESDHC=y
CONFIG_LED=y
CONFIG_LED_GPIO=y
CONFIG_LED_GPIO_RGB=y
CONFIG_LED_TRIGGERS=y
CONFIG_MISC=y
CONFIG_AT24=y
CONFIG_ISL22316=y
```

## drivers/eeprom/Kconfig
```kconfig
menu "EEPROM support"

config EEPROM_AT25
	tristate "SPI EEPROMs from most vendors"
	depends on SPI
	help
	  Enable this driver to get read/write support to most SPI EEPROMs,
	  after you configure the board init code to know about each eeprom
	  on your target board.

config EEPROM_AT24
	bool "at24 based eeprom"
	depends on I2C
	help
	  Provides read/write for the at24 family of I2C EEPROMS.
	  Currently only the 2K bit versions are supported.
	  
endmenu
```

## drivers/misc/Kconfig
```kconfig
menuconfig MISC
	bool "Misc devices support"

if MISC

config ISL22316
	bool "isl22316 digital controlled potentiometer"
	depends on I2C

config ISL22346
	bool "isl22346 digital controlled potentiometer"
	depends on I2C

endif
```
